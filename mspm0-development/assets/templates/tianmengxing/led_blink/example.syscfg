/**
 * 嘉立创天猛星 MSPM0G3507 板载 PB22 LED 的 SysConfig 示例。
 * 元数据基线为 MSPM0 SDK 2.10.00.04 和 SysConfig 1.27.0；
 * 当前发布证据以同目录 manifest.json 为准。
 *
 * @cliArgs --device "MSPM0G350X" --part "Default" --package "LQFP-64(PM)" --product "mspm0_sdk@2.10.00.04"
 * @versions {"tool":"1.27.0+4565"}
 */

const GPIO   = scripting.addModule("/ti/driverlib/GPIO", {}, false);
const GPIO1  = GPIO.addInstance();
const SYSCTL = scripting.addModule("/ti/driverlib/SYSCTL");

GPIO1.$name                          = "LED";
GPIO1.associatedPins.create(1);
GPIO1.associatedPins[0].$name        = "PIN_22";
GPIO1.associatedPins[0].initialValue = "CLEARED";
GPIO1.associatedPins[0].assignedPort = "PORTB";
GPIO1.associatedPins[0].assignedPin  = "22";
GPIO1.associatedPins[0].pin.$assign  = "PB22";

const Board = scripting.addModule("/ti/driverlib/Board", {}, false);

SYSCTL.forceDefaultClkConfig = true;

Board.peripheral.$suggestSolution            = "DEBUGSS";
Board.peripheral.swclkPin.$suggestSolution   = "PA20";
Board.peripheral.swdioPin.$suggestSolution   = "PA19";
SYSCTL.peripheral.$suggestSolution           = "SYSCTL";
